// MUTANT flash_no_exit: the reset sequence skips the flash's continuous-read exit. Window w0 (8 edges with SD0-SD3 high) is gone: a flash that powers up in continuous read takes the 0xEB command as an address and M byte and drives data while the core still drives SD0-SD3 (contract 2.1.6, 2.4).
// Generated by verif/formal/mutants/make_mutants.py from the champion.
/*
 * BonettoR32V memory controller for TT's QSPI Pmod (docs/contract.md sections 2 and 3), quad.
 *
 * - Reset sequence (contract 2.4), before the core starts, one 32-cycle window per transaction
 *   (counter `b`, reset to 255 = idle, so both CS_n are high during reset; the core waits for
 *   `booting` to fall):
 *     w0       flash: 8 edges with SD0-SD3 high (leaves continuous read, or the no-op 0xFF);
 *     w1       PSRAM: 0xF5 in QPI form (2 edges; an ignored partial command in SPI mode);
 *     w2, w3   PSRAM: 0x66, 0x99 in SPI form (SPI mode, initialized);
 *     w4-w5    flash: 0xEB, 6 quad address edges, M = 0x20, then CS_n high inside the dummy
 *              field: the flash is in continuous read from here on;
 *     w6       PSRAM: 0x35 in SPI form (QPI mode from here on).
 * - Program address: the core supplies the address register's odd nibbles `pa_odd` and bit 24
 *   `pa24` (the chip, 1 = PSRAM): the pc for a fetch, the load or store address for M. The
 *   register rotates by one nibble per header nibble, so each address nibble is at an odd
 *   position when its turn comes. `ps` holds the chip of the slot's transaction, steady while the
 *   pc rotates or the
 *   ring takes data: a fetch loads it at its gap; A's data strobes load a load/store address's
 *   bit 24 (and bit 31 into `io`).
 * - Transactions: the core loads `sdo` with a header nibble (hdr_ld, index hidx) or a data
 *   nibble (dat_ld) at the clocks where SCK stays or goes low. Headers:
 *     flash (program access with ps = 0, continuous read): A[23:20] .. A[3:0], 0x2, 0x0 (M);
 *     PSRAM (QPI): 0x0, 0xB (read) or 0x2 (write), A[23:20] .. A[3:0]; core-region words at
 *     0xFFFF80 | {1, regarea, rsel, 00} (A[23] is ignored).
 *   `sdoe` drives SD0-SD3 from each slot's start; a read releases them after its 8 header
 *   edges, for the dummy/wait edges and the data. PSRAM B's CS_n is constant 1.
 *
 * Copyright 2026 Felipe Sens Bonetto
 * SPDX-License-Identifier: Apache-2.0
 */

`default_nettype none

module r32v_mem (
    input  wire        clk,
    input  wire        rst_n,
    // address flags (from the A slot's data strobes)
    input  wire        cap_a,      // an A data strobe
    input  wire [2:0]  kn,         // its nibble index
    input  wire [3:0]  din4,       // its result nibble
    output wire        io,
    output wire        ps,
    output wire        booting,
    input  wire [5:0]  bc,         // reset sequence counter bits 5:0 (the core's c)
    // transaction (from the core's engine)
    input  wire        active,     // a CS_n is low (an unmasked slot past its gap)
    input  wire        prog,       // program transaction (F, M): address from pa_odd
    input  wire        fetch,      // the slot is F
    input  wire        pa24,       // address bit 24 (a fetch's chip)
    input  wire [15:0] pa_odd,     // address register nibbles 7, 5, 3, 1 (rotating in the header)
    input  wire        sck,
    input  wire        gap,        // the cycle between transactions
    input  wire        hdr_ld,     // load header nibble hidx into sdo
    input  wire [2:0]  hidx,
    input  wire        h_wr,       // the slot writes
    input  wire [4:0]  h_reg,      // core-region word {regarea, rsel[3:0]}
    input  wire        dat_ld,     // load data nibble wd4 into sdo
    input  wire [3:0]  wd4,
    input  wire        oe_off,     // a read's header ends: release SD0-SD3
    output wire [7:0]  uio_out,
    output wire [7:0]  uio_oe
);

    // ------------------------------------------------------------------------------------
    // Address flags
    // ------------------------------------------------------------------------------------
    wire _unused_din = &{din4[2:1], 1'b0};
    wire fchip = pa24;                                  // a fetch's chip (pc bit 24)
    // scan flops holding through SCD (D = the next value, SCD = Q, SCE = hold)
    wire ps_ld = gap & fetch;
    sky130_fd_sc_hd__sdfxtp_1 u_ps (.CLK(clk), .D(ps_ld ? fchip : din4[0]), .SCD(ps),
                                    .SCE(~(ps_ld | (cap_a & (kn == 3'd6)))), .Q(ps));
    sky130_fd_sc_hd__sdfxtp_1 u_io (.CLK(clk), .D(din4[3]), .SCD(io),
                                    .SCE(~(cap_a & (kn == 3'd7))), .Q(io));

    // ------------------------------------------------------------------------------------
    // Header nibbles
    // ------------------------------------------------------------------------------------
    wire        flash = prog & ~((gap & fetch) ? fchip : ps);   // the gap loads header nibble 0
    // The address register rotates by one nibble at each header nibble load (the core's
    // rot_hdr), so address nibble k sits at position k - hidx: flash header nibble hidx = 0..5
    // (A nibble 5 - hidx) is at 5 - 2 hidx, PSRAM nibble hidx = 2..7 (A nibble 7 - hidx) at
    // 7 - 2 hidx, always an odd position: pa_odd's nibble (2 + psram - hidx) mod 4.
    wire [1:0]  ai    = 2'd2 + {1'b0, ~flash} - hidx[1:0];
    reg  [3:0]  an;
    always @(*) begin
        case (ai)
            2'd0:    an = pa_odd[3:0];
            2'd1:    an = pa_odd[7:4];
            2'd2:    an = pa_odd[11:8];
            default: an = pa_odd[15:12];
        endcase
    end
    reg  [3:0] hn;
    always @(*) begin
        case ({flash, hidx})
            4'b1110: hn = 4'h2;                         // M = 0x20: stay in continuous read
            4'b1111: hn = 4'h0;
            4'b0000: hn = 4'h0;
            4'b0001: hn = h_wr ? 4'h2 : 4'hB;           // QPI 0x02 write, 0x0B read
            4'b0110: hn = prog ? an : {1'b1, h_reg[4:2]};
            4'b0111: hn = prog ? an : {h_reg[1:0], 2'b00};
            default: hn = (flash | prog) ? an : 4'hF;   // flash 0-5; PSRAM 2-5
        endcase
    end

    wire [3:0] sdo;
    reg        sdoe;
    wire [3:0] sdo_d = hdr_ld ? hn : dat_ld ? wd4 : 4'h0;
    wire       sdo_h = ~(hdr_ld | dat_ld | gap);
    genvar gi;
    generate
        for (gi = 0; gi < 4; gi = gi + 1) begin : g_sdo
            sky130_fd_sc_hd__sdfxtp_1 u_sdo (.CLK(clk), .D(sdo_d[gi]), .SCD(sdo[gi]), .SCE(sdo_h),
                                             .Q(sdo[gi]));
        end
    endgenerate
    always @(posedge clk) begin
        if (gap)
            sdoe <= 1'b1;
        else if (oe_off)
            sdoe <= 1'b0;
    end

    // ------------------------------------------------------------------------------------
    // Reset sequence: window w = b[7:5], position p = b[4:0]; w4-w5 is one 64-cycle window
    // ------------------------------------------------------------------------------------
    // b[5:0] is the core's edge counter c, which counts every clock while booting (reset to 63);
    // bh, b[7:6], steps when it wraps
    reg  [1:0] bh;
    reg        done;
    wire [7:0] b    = {bh, bc};
    wire [2:0] w    = b[7:5];
    wire [4:0] p    = b[4:0];
    wire       fe   = (w[2:1] == 2'b10);                 // w4, w5: flash enter, position b[5:0]
    wire       fl   = (w == 3'd0) | fe;                  // a flash window
    wire [2:0] e    = p[3:1];                           // edge index in an 8-edge window
    wire [3:0] ef   = b[4:1];                           // edge index in the flash-enter window
    wire       lo8  = ~p[4] | (p[3:0] == 4'd0);         // p <= 16: 8 edges, then SCK low
    wire       lo2  = ~p[4] & ~p[3] & (~p[2] | (p[1:0] == 2'd0));   // p <= 4: 2 edges
    wire       lo16 = ~b[5] | (p == 5'd0);              // b[5:0] <= 32: 16 edges
    wire       blo  = ~done & (fe ? lo16 : (w == 3'd1) ? lo2 : (w != 3'd7) & (w != 3'd0) & lo8);
    wire       bsck = blo & p[0];
    wire       bcsf = ~(blo & fl);
    wire       bcsr = ~(blo & ~fl);
    // SD0 of the single commands: 0x66 = 0110 0110, 0x99 = 1001 1001, 0x35 = 0011 0101,
    // 0xEB = 1110 1011
    wire       c66  = e[0] ^ e[1];
    wire       c35  = e[2] ? e[0] : e[1];
    wire       ceb  = ~((ef[2:0] == 3'd3) | (ef[2:0] == 3'd5));
    reg  [3:0] bsd;
    always @(*) begin
        case (w)
            3'd1:    bsd = p[1] ? 4'h5 : 4'hF;          // QPI 0xF5
            3'd2:    bsd = {3'b111, c66};
            3'd3:    bsd = {3'b111, ~c66};
            3'd4, 3'd5:                                 // 0xEB, address 0, M = 0x20
                     bsd = ef[3] ? {2'b00, ef[2:0] == 3'd6, 1'b0} : {3'b000, ceb};
            3'd6:    bsd = {3'b111, c35};
            default: bsd = 4'hF;
        endcase
    end
    always @(posedge clk) begin
        if (!rst_n) begin
            bh   <= 2'b11;                              // b = 255: idle (w7) during reset
            done <= 1'b0;
        end else if (!done) begin
            if (&bc)
                bh <= bh + 2'd1;
            done <= (b == 8'd211);                      // 0x35 ended at 209
        end
    end
    assign booting = ~done;

    // ------------------------------------------------------------------------------------
    // Pins
    // ------------------------------------------------------------------------------------
    wire       csf = done ? ~(active & flash) : bcsf;
    wire       csr = done ? ~(active & ~flash) : bcsr;
    wire       sk  = done ? (sck & active) : bsck;
    wire [3:0] sd  = done ? sdo : bsd;
    wire       oe  = ~done | sdoe;
    assign uio_out = {1'b1, csr, sd[3], sd[2], sk, sd[1], sd[0], csf};
    assign uio_oe  = {2'b11, oe, oe, 1'b1, oe, oe, 1'b1};

endmodule

`default_nettype wire
