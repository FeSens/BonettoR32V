// MUTANT sd_low: samples SD0-SD3 while SCK is low. The data nibble goes through an extra flip-flop, so a strobe reads the value from the clock before the rising edge (noise). The v2 miso_low.
// Generated by verif/formal/mutants/make_mutants.py from the champion.
/*
 * BonettoR32V MCU (contract v3, docs/contract.md): a nibble-serial RV32E core with x1..x10,
 * x12..x15, mtvec, mscratch and mepc in the PSRAM core region and x11 and the pc on the die, on
 * TT's QSPI Pmod in quad mode (code runs from flash in continuous read, data in PSRAM in QPI
 * mode), with a minimal Zicsr, traps and one interrupt to mtvec, and the contract-5 peripherals.
 *
 * Modules: r32v_mem (reset sequence, the transaction chip, header nibbles, pins), r32v_csr (CSR
 * state and the trap/interrupt flags), r32v_periph (IO slots, the interrupt line). This file:
 * the slot engine, the nibble-serial datapath, the pc, decode and sequencing.
 *
 * Slots. Every slot is one quad transaction at SCK = clk/2: E SCK edges take 2E + 2 clocks
 * (a gap clock with CS_n high, the edges, a tail clock with SCK low).
 *   read:  8 header edges (r32v_mem), 4 dummy/wait edges, 8 data edges: 42 clocks
 *   write: 8 header edges, 2/4/8 data edges: 22/26/34 clocks
 * The counter c counts SCK edges: it starts at 52 (read) or 56 (write) and wraps to 0 at the
 * first data edge, so c is the data nibble index in the data phase (while booting, c is the low
 * 6 bits of the memory reset sequence's counter instead). A masked slot (x0, x11, or no
 * register) keeps CS_n high and SCK low and runs only its 8 data strobes, one per clock: the
 * internal sck stays high through its data phase (10 clocks). Data moves at the clock where SCK
 * falls (the strobe): a read samples nibble c there, a write loads the nibble for the next
 * rising edge.
 *
 * x11. a1r holds x11 (the multiply routine's operand, RV32E having no M), nibble k at
 * a1r[4k+3:4k], so a slot of x11 (A for rs1, B or BS for rs2, W or W4 for rd) is a fast slot
 * like a masked one: no transaction, 8 strobes in 10 clocks. a1r does not shift: a read takes
 * nibble c through a nibble mux in place of the bus nibble at strobe c, a write loads the
 * emitted nibble into nibble c (no flop feeds another). A fast W of a shift first runs its
 * header rotation (rotn nibbles) in rotn + 1 header strobes, one per clock (none when
 * rotn = 0). The core region's x11 word is unused.
 *
 * Ring. ring is a 32-bit shift register of 8 nibbles. A read slot shifts its result nibble in at
 * the top at each data strobe; a write slot rotates it (head ring[3:0] to the top) and emits
 * from it. After 8 strobes a value sits with nibble k at ring[4k+3:4k]. Core-region words are
 * stored LSB nibble first; program data arrives high nibble first in each byte, so loads (in W)
 * and stores (in M) emit ring[7:4] on even strobes and ring[31:28] on odd ones. Loads always
 * read 4 bytes. Shifts: W rotates the ring by q nibbles (shamt = 4q + r) during its own header
 * (a right shift brings in the zero or sign fill at the top instead), then emits
 * ({ring[7:4], ring[3:0]} >> r) with zero or sign fill.
 *
 * pc. pcr is a second 8-nibble shift register: it holds the pc with nibble k at pcr[4k+3:4k],
 * so the fetch header reads its address nibbles (and bit 24, the chip) straight from it: F and M
 * rotate pcr and the ring by one nibble per header nibble (8 in all), so each address nibble is
 * at an odd position when its turn comes and r32v_mem selects among 4 nibbles, not 6. A slot
 * that updates the pc shifts the new nibble in at the top at each of its 8 data strobes and
 * reads the old one at the head (pk4). The memory reset sequence (`booting`) shifts zeros into
 * it, so the first fetch is at 0 in flash. pcr is also the address register: a load's
 * M header takes the address from the ring (A leaves it there); a store spills pc + 4 to the
 * core region's x0 word (WP), leaves its address in pcr for M and the IO slot, and reloads the pc
 * (P); a register shift does the same around B, which leaves rs2[4:0] (the amount) in pcr. An
 * IO store restores the pc before BS, so its write lands at its retirement. A taken branch on
 * x0 retires with its target in the ring instead (`tk`): the next F takes its address from the
 * ring and moves it into pcr at its strobes; an interrupt entry's WC writes it to mepc.
 *
 *   F   READ  pc -> instruction register; at the same strobes ring <- pc + 4
 *   P   READ  x0 (the spilled pc + 4) -> pc; the ring rotates by 2 nibbles (an IO store's address
 *             nibbles 0-1 to the top)
 *   A   READ  rs1 -> ALU (+imm; AUIPC: pc + imm; CSR: rs1 or zimm; branches: rs1 + 0) -> ring
 *             (a store: and pcr); at the same strobes pc <- the ring's pc + 4, except for
 *             branches, JALR and stores; JALR: pc <- the target, or the pc rotates if the target
 *             traps (the ring keeps pc + 4); an IO load captures the slot into the ring at A's
 *             tail. A branch on x0 compares rs1 with 0 beside the ALU, which computes pc + imm
 *             into the ring, and moves pc + 4 into pcr (not when imm[1] = 1: that target traps
 *             if taken, so the pc stays; untaken, X adds 4)
 *   B   READ  rs2 -> ALU with the ring (OP, branches); register shifts: rs2 -> pcr
 *   BS  READ  rs2 -> ring (store data); an IO store takes nibbles 0-5 only (rs2[15:0] lands in
 *             ring[23:8], under the address nibbles 0-1 in ring[7:0]) and writes the slot at BS's
 *             tail
 *   C   READ  a CSR: core-region word (masked bits read 0) or the die bits -> ring; in a trap
 *             sequence (mtvec) and in MRET (mepc) -> pc
 *   RS  READ  scratch, combined with the ring (CSRRW / CSRRS / CSRRC) -> ring
 *   X   no transaction (masked, 10 clocks): pc <- pc + (taken branch ? imm : 4)
 *   M   READ/WRITE the load/store address (4 bytes / the store's bytes); a store to flash is
 *             masked
 *   W4  WRITE rd <- the ring (pc + 4); JAL: pc <- pc + imm
 *   WP  WRITE x0 <- the ring (pc + 4, the spill)
 *   W   WRITE rd <- ring (forward, load bytes extended, shifted, SLT); LI (ADDI rd, x0, imm)
 *             and LUI: rd <- the immediate, and pc <- the ring's pc + 4 at the same strobes
 *   WS  WRITE scratch <- ring;  WC: the CSR <- ring (in a trap sequence: mepc <- pc)
 * Sequences: ALU F A [B] W (register shifts F WP A B W P; LI, LUI F W); load F A M W (IO: F A
 * W); store F WP A BS M P (IO: F WP A P BS); branch F A B X, on x0 F A (imm[1] = 1, untaken:
 * F A X); JAL F W4; JALR F A W4 (rd = x0: F A); FENCE, WFI F X;
 * CSR F A WS C W RS WC; MRET F C. A
 * synchronous trap (decode after F, JALR after A, branch after A or B) leaves the pc unchanged,
 * runs WC(mepc <- pc) C(pc <- mtvec) and retires; an interrupt (at a retirement) runs WC C and
 * continues with the handler's F.
 *
 * Copyright 2026 Felipe Sens Bonetto
 * SPDX-License-Identifier: Apache-2.0
 */

`default_nettype none

module tt_um_fesens_r32v (
    input  wire [7:0]  ui_in,
    output wire [7:0]  uo_out,
    input  wire [7:0]  uio_in,
    output wire [7:0]  uio_out,
    output wire [7:0]  uio_oe,
    input  wire        ena,
    input  wire        clk,
    input  wire        rst_n
`ifdef RISCV_FORMAL
    ,
    output wire        rvfi_valid,
    output wire [63:0] rvfi_order,
    output wire [31:0] rvfi_insn,
    output wire        rvfi_trap,
    output wire        rvfi_halt,
    output wire        rvfi_intr,
    output wire [1:0]  rvfi_mode,
    output wire [1:0]  rvfi_ixl,
    output wire [4:0]  rvfi_rs1_addr,
    output wire [4:0]  rvfi_rs2_addr,
    output wire [31:0] rvfi_rs1_rdata,
    output wire [31:0] rvfi_rs2_rdata,
    output wire [4:0]  rvfi_rd_addr,
    output wire [31:0] rvfi_rd_wdata,
    output wire [31:0] rvfi_pc_rdata,
    output wire [31:0] rvfi_pc_wdata,
    output wire [31:0] rvfi_mem_addr,
    output wire [3:0]  rvfi_mem_rmask,
    output wire [3:0]  rvfi_mem_wmask,
    output wire [31:0] rvfi_mem_rdata,
    output wire [31:0] rvfi_mem_wdata
`endif
);

    // Slot types: sl[4:3] = 00 READ into the ring, 01 program address, 1x WRITE from the ring
    // (X: no transaction, always masked)
    localparam [4:0] SL_P  = 5'b00000, SL_A  = 5'b00001, SL_X  = 5'b00010, SL_B  = 5'b00011,
                     SL_BS = 5'b00100, SL_C  = 5'b00101, SL_RS = 5'b00110,
                     SL_F  = 5'b01000, SL_M  = 5'b01001,
                     SL_WP = 5'b10000, SL_W4 = 5'b10010, SL_W = 5'b10011, SL_WS = 5'b10100,
                     SL_WC = 5'b10101;
    // Engine phases
    localparam [1:0] E_GAP  = 2'b00,     // CS_n high, SCK low (one clock; waits while booting)
                     E_HDR  = 2'b01,     // header and dummy edges
                     E_DATA = 2'b10,     // data edges
                     E_TAIL = 2'b11;     // SCK low, CS_n still low: the slot's events

    reg  [4:0]  sl;
    reg  [1:0]  ep;
    wire [5:0]  c;      // SCK edge counter: 52/56..63 header, 0..7 data
    reg         sck;
    reg         tk;     // a taken branch on x0 retired: the pc is in the ring, not in pcr
    wire        cy;     // ALU carry; sign latch of a load's W
    wire        cmp;    // compare; JALR target[1] == 0; a shift's sign bit
    wire        mk;     // the slot is masked (mask, registered at the gap clock)
    wire [31:0] ring;   // operand/result ring
    wire [31:0] ir;     // instruction register, in wire nibble order
    wire [31:0] pcr;    // the pc
    wire [31:0] a1r;    // x11, nibble k at a1r[4k+3:4k]
    wire        x11r;   // the slot reads or writes x11 (x11, registered at the gap clock)

    wire _unused = &{ena, uio_in[7:6], uio_in[3], uio_in[0], 1'b0};

    // ------------------------------------------------------------------------------------
    // Decode, spec-minimum (contract 4). Traps: insn[0] = 0 (the all-zeros word) and
    // opcode[6] & [4] & [2] (the all-ones word) are illegal (2), ECALL (11), EBREAK (3), a
    // misaligned JAL (0). Every other encoding executes as the class its opcode bits select;
    // register fields use 4 bits.
    // ------------------------------------------------------------------------------------
    wire [31:0] insn  = {ir[7:4], ir[3:0], ir[15:12], ir[11:8], ir[23:20], ir[19:16],
                         ir[31:28], ir[27:24]};
    wire [2:0]  f3    = insn[14:12];
    wire [3:0]  rd_f  = insn[10:7];
    wire [3:0]  rs1_f = insn[18:15];
    wire [3:0]  rs2_f = insn[23:20];
    wire        _unused_insn = insn[1];
    wire        spill = c_st | (c_op & c_sh);          // stores and register shifts spill the pc

    wire c_br    = insn[6] & ~insn[4] & ~insn[2];
    wire c_sys   = insn[6] &  insn[4] & ~insn[2];
    wire c_jalr  = insn[6] &  insn[2] & ~insn[3];
    wire c_jal   = insn[6] &  insn[2] &  insn[3];
    wire c_mem   = ~insn[6] & ~insn[4] & ~insn[2];
    wire c_fence = ~insn[6] & ~insn[4] & insn[2];
    wire c_st    = c_mem & insn[5];
    wire c_ld    = c_mem & ~insn[5];
    wire c_u     = ~insn[6] & insn[4] & insn[2];
    wire c_pcrel = c_u & ~insn[5];                      // AUIPC: ring (pc) + imm
    wire c_alu   = ~insn[6] & insn[4] & ~insn[2];
    wire c_op    = c_alu & insn[5];
    wire c_sh    = c_alu & (f3[1:0] == 2'b01);
    wire c_slt   = c_alu & (f3[2:1] == 2'b01);
    wire sh_left = ~f3[2];
    wire [1:0] nm1 = {f3[1], f3[1] | f3[0]};            // access bytes - 1
    wire priv    = c_sys & (f3[1:0] == 2'b00);          // ECALL, EBREAK, MRET, WFI
    wire c_csr   = c_sys & (f3[1:0] != 2'b00);
    wire p_mret  = priv & insn[21];
    wire p_trap  = priv & ~insn[21] & ~insn[22];        // ECALL (insn[20] = 0), EBREAK
    wire trap_ill = ~insn[0] | (insn[6] & insn[4] & insn[2]);
    wire trap_dec = trap_ill | (c_jal & insn[21]) | p_trap;
    wire [3:0] cause = {p_trap & ~trap_ill & ~insn[20], 1'b0, trap_ill | p_trap, p_trap & ~trap_ill};
    wire rs2z    = (rs2_f == 4'd0);
    wire nb      = c_br & rs2z;                         // a branch on x0: no B, no X
    wire nbw     = nb & ~insn[8];                       // ... whose A moves pc + 4 into pcr
    // LI (ADDI rd, x0, imm) and LUI: no A; W writes the immediate and moves pc + 4 into pcr
    wire liw     = (c_alu & ~insn[5] & (f3 == 3'b000) & (rs1_f == 4'd0)) | (c_u & insn[5]);

    wire fR   = ~sl[4] & ~sl[3];
    wire fM   = ~sl[4] &  sl[3];
    wire fW   =  sl[4];
    wire sP   = (sl == SL_P);
    wire sA   = (sl == SL_A);
    wire sX   = (sl == SL_X);
    wire sB   = (sl == SL_B);
    wire sBS  = (sl == SL_BS);
    wire sC   = (sl == SL_C);
    wire sRS  = (sl == SL_RS);
    wire sF   = (sl == SL_F);
    wire sM   = (sl == SL_M);
    wire sW4  = (sl == SL_W4);
    wire sW   = (sl == SL_W);
    wire sWS  = (sl == SL_WS);
    wire sWC  = (sl == SL_WC);
    wire shB  = sB & c_sh;
    wire gap  = (ep == E_GAP);
    wire hdr  = (ep == E_HDR);
    wire e_end = (ep == E_TAIL);
    wire wr   = fW | (sM & c_st);                       // the slot writes

    // submodule wires
    wire        tm, intr, irq, take, booting;
    wire        csr_region, mask_lo2;
    wire [3:0]  rd_die;
    wire [1:0]  csr_idx;
    wire        io, ps;
    wire [15:0] io_rdata;

    // ------------------------------------------------------------------------------------
    // Slot control
    // ------------------------------------------------------------------------------------
    wire csr_sl  = sC | sWC;
    wire scr     = sWS | sRS;                           // the scratch word 0x80
    wire regarea = ~scr & ~csr_sl;                      // x1..x15 at 0xC0 + 4r
    wire [3:0] rsel = sA ? rs1_f : (sB | sBS) ? rs2_f : (sW | sW4) ? rd_f :
                      csr_sl ? {2'b01, csr_idx} : 4'd0;
    wire za   = c_u | (c_csr & f3[2]);                  // A reads 0 whatever rs1_f holds
    // x11 lives on the die (a1r): its slots (A for rs1, B and BS for rs2, W and W4 for rd) run
    // as fast slots, like the masked ones, and take or give the nibbles of a1r
    wire x11  = (rsel == 4'd11) & ~(sA & za);
    wire mask = (sA & (za | (rs1_f == 4'd0))) |
                ((sB | sBS) & rs2z) |
                ((sW | sW4) & (rd_f == 4'd0)) |
                (csr_sl & ~csr_region) |
                (sM & c_st & ~ps) |                     // a store to flash issues nothing
                sX | x11;
    // every input of mask is constant from a slot's gap to its tail, so the slot uses mk
    wire active = ~gap & ~mk;
    wire wact   = wr & ~mk;                             // the slot drives data on the bus
    reg  [3:0] nib_q;
    always @(posedge clk) nib_q <= {uio_in[5], uio_in[4], uio_in[2], uio_in[1]};
    wire [3:0] nib   = nib_q;
    // x11's nibble c in an x11 slot, else 0 (an x11 slot is fast: its nibble index n is c[2:0])
    reg  [3:0] a1n;
    always @(*) begin
        case ({x11r, c[2:0]})
            4'b1000: a1n = a1r[3:0];
            4'b1001: a1n = a1r[7:4];
            4'b1010: a1n = a1r[11:8];
            4'b1011: a1n = a1r[15:12];
            4'b1100: a1n = a1r[19:16];
            4'b1101: a1n = a1r[23:20];
            4'b1110: a1n = a1r[27:24];
            4'b1111: a1n = a1r[31:28];
            default: a1n = 4'd0;
        endcase
    end
    // 0 in a masked slot, x11's nibble in an x11 slot (x11r implies mk); 0 while booting (sl = F)
    wire [3:0] nib_m = (nib & {4{active}}) | a1n;

    // strobes: stb = the clock where SCK is high (it falls at its edge)
    wire       stb   = sck;
    wire [5:0] cn    = c + 6'd1;
    wire [2:0] nlast = (sM & c_st) ? {nm1, 1'b1} : 3'd7;
    wire       dend  = stb & ~c[5] & (c[2:0] == nlast); // the last data edge's strobe
    // data strobe: a read samples nibble c; a write (on the bus) loads nibble c + 1 for the
    // next rising edge; a masked slot of either kind steps like a read
    wire       dstb  = wact ? (stb & ~cn[5] & ~dend) : (stb & ~c[5]);
    wire [2:0] n     = wact ? cn[2:0] : c[2:0];         // data nibble index at dstb (a masked
                                                        // W4 still updates the pc)
    wire       n0    = (n == 3'd0);

    // ------------------------------------------------------------------------------------
    // Immediate nibble n (bits 4n+3 .. 4n)
    // ------------------------------------------------------------------------------------
    wire       sign = insn[31];
    wire       zi   = c_sys & f3[2];                    // CSR immediate forms: zimm
    // One instruction nibble select serves every format: nibble 5, 6, 7 for n = 0, 1, 2 (I, and
    // S, B, J with the bits patched below), nibble n for n >= 3 (U, J)
    reg  [3:0] inib;
    always @(*) begin
        case (n)
            3'd3:       inib = insn[15:12];
            3'd4:       inib = insn[19:16];
            3'd0, 3'd5: inib = insn[23:20];
            3'd1, 3'd6: inib = insn[27:24];
            default:    inib = insn[31:28];
        endcase
    end
    wire       lo3  = ~n[2] & ~(n[1] & n[0]);           // n = 0..2
    wire       n1   = (n == 3'd1);
    wire       n2   = (n == 3'd2);
    wire       sb   = c_st | c_br;
    // n = 0: S insn[10:7], B {insn[10:8], 0}, J {insn[23:21], 0}; n = 1: S, B {insn[27:25],
    // insn[11]}; n = 2: B {insn[7], insn[30:28]}, J {insn[20], insn[30:28]}; CSR: zimm
    wire [3:0] lo4  = c_sys ? ({insn[18:16] & {3{n0}}, insn[15] & n0 | insn[19] & n1} & {4{zi}}) :
                      {n2 & c_jal ? insn[20] : n2 & c_br ? insn[7] : n0 & sb ? insn[10] : inib[3],
                       n0 & sb ? insn[9:8] : inib[2:1],
                       n0 ? (sb ? (c_st & insn[7]) : (inib[0] & ~c_jal)) :
                       (n1 & sb) ? insn[11] : inib[0]};
    wire [3:0] imm4 = lo3 ? (lo4 & {4{~c_u}}) :
                      (c_u | (c_jal & ~n[2] & n[1] & n[0]) | (c_jal & n[2] & ~n[1] & ~n[0])) ? inib :
                      {4{sign & ~c_sys}};

    // ------------------------------------------------------------------------------------
    // Nibble ALU (also the pc's arithmetic: F's pc + 4, X, W4 of JAL)
    // ------------------------------------------------------------------------------------
    wire       taken  = cmp ^ f3[0];
    wire [3:0] four   = {1'b0, n0, 2'b00};
    wire [3:0] pk4    = pcr[3:0];                       // pc nibble n
    wire       bimm_a = ~(c_op | c_sh | (c_br & ~rs2z));
    // the pc operand: pcr, or the ring in a fetch after a taken branch on x0 (tk)
    wire       a_pc   = (sF & ~tk) | (sA & (c_pcrel | nb)) | sX | (sW4 & c_jal);
    wire       rsb    = sRS & f3[1];                   // CSRRS, CSRRC: ring op scratch
    wire [3:0] a4     = a_pc ? pk4 : (sB | sW4 | (sF & tk) | rsb) ? ring[3:0] : nib_m;
    wire [3:0] b4     = sA ? (imm4 & {4{bimm_a}}) :
                        (sB | rsb) ? nib_m :
                        sF ? four :
                        sX ? ((c_br & taken) ? imm4 : four) :
                        (sW4 & c_jal) ? imm4 : 4'd0;
    // A: SLTI/SLTIU compare rs1 with imm; B: SUB, SLT, SLTU and branches subtract
    wire       sub    = sA ? c_slt : ((sB & (c_br | (~f3[2] & (f3[1] | insn[30])))) |
                                       (rsb & f3[0]));
    wire [3:0] b_x    = b4 ^ {4{sub}};
    wire       cin    = n0 ? sub : cy;
    wire [4:0] add    = {1'b0, a4} + {1'b0, b_x} + {4'd0, cin};
    wire [3:0] sum    = add[3:0];
    wire       cout   = add[4];
    wire [3:0] pp     = a4 ^ b_x;
    wire [3:0] gg     = a4 & b_x;
    wire [3:0] boolr  = (pp & {4{~f3[0]}}) | (gg & {4{f3[1]}});
    wire       sgnd   = c_br ? ~f3[1] : ~f3[0];
    wire       lt     = cout ^ (pp[3] | ~sgnd);
    wire [3:0] sumj   = {sum[3:1], sum[0] & ~(n0 & c_jalr)};   // JALR clears target bit 0
    wire       eqacc  = ~(|sumj) & (cmp | n0);
    wire       ocmp   = (c_br & ~f3[2]) ? eqacc : lt;
    // A of a branch compares rs1 with 0 beside the ALU: equal (all nibbles 0), signed less
    // (rs1[31], the last nibble's), unsigned less (never); B recomputes it when rs2 != x0
    wire       zc     = f3[2] ? (~f3[1] & nib_m[3]) : (~(|nib_m) & (cmp | n0));
    // logic ops: XORI, ORI, ANDI in A; XOR, OR, AND in B (a B result with f3 = 001..011 is
    // unused); CSRRS, CSRRC in RS
    wire       useb   = (sA & c_alu & ~insn[5] & f3[2] & ~c_sh) | (sB & f3[2]) | rsb;
    wire [3:0] alu_w  = useb ? boolr : sumj;

    // C: a core-region CSR word (bits 1:0 of mtvec and mepc read 0) or the die bits.
    // RS goes through the ALU: CSRRW adds 0 to the scratch word (rs1 or zimm), CSRRS and CSRRC
    // take ring | scratch and ring & ~scratch from its logic ops.
    wire [3:0] c4    = csr_region ? (nib_m & {2'b11, {2{~mask_lo2}}}) : rd_die;
    wire [3:0] din4   = sC ? c4 : alu_w;

    // ------------------------------------------------------------------------------------
    // Write family emission, nibble n at the data strobe (before the ring rotates)
    // ------------------------------------------------------------------------------------
    // program data (load bytes in W, store bytes in M): byte nibbles swapped
    wire [3:0] tap4   = n[0] ? ring[31:28] : ring[7:4];
    // loads: IO slots have 16 bits, so an IO LW is an LHU
    wire [1:0] nm1_l  = io ? {1'b0, nm1[0]} : nm1;
    wire       ldfill = (n[2:1] > nm1_l);
    wire       fillv  = ~f3[2] & cy & ~(io & f3[1]);
    // shifts: shamt = 4q + r; right: the ring is shifted by q with the fill coming in at the top,
    // emit ({next, head} >> r) (next is the fill at n = 7); left: rotated by -q - (r != 0), emit
    // ({next, head} >> (4 - r) mod 4) with zeros below the shifted value
    wire [4:0] shamt  = c_op ? pcr[4:0] : insn[24:20];
    wire [2:0] q      = shamt[4:2];
    wire [1:0] r      = shamt[1:0];
    wire       rnz    = |r;
    wire [2:0] rotn   = sh_left ? (~q + {2'b00, ~rnz}) : q;
    wire [1:0] amt    = sh_left ? (~r + 2'd1) : r;
    // a fast shift W (rd = x11, or x0) runs rotn + 1 header strobes, one per clock, when rotn > 0
    wire       fh     = sW & c_sh & (|rotn);
    wire [3:0] qh     = {1'b0, q} + {3'b000, rnz};
    wire       hv     = ~sh_left | ({1'b0, n} >= qh);
    wire       nv     = sh_left ? (n >= q) : (n != 3'd7);
    wire       shf    = ~sh_left & insn[30] & cmp;      // SRA fill: rs1[31], latched in A
    wire [3:0] hd     = hv ? ring[3:0] : {4{shf}};
    wire [2:0] nx     = nv ? ring[6:4] : {3{shf}};
    reg  [3:0] fun;
    always @(*) begin
        case (amt)
            2'd0: fun = hd;
            2'd1: fun = {nx[0], hd[3:1]};
            2'd2: fun = {nx[1:0], hd[3:2]};
            default: fun = {nx, hd[3]};
        endcase
    end
    wire [3:0] wd4    = c_ld  ? (ldfill ? {4{fillv}} : tap4) :
                        c_slt ? {3'b000, n0 & cmp} :
                        c_sh  ? fun :
                        liw   ? imm4 :
                                ring[3:0];
    // a trap sequence's WC (mepc): the pc (from the ring after a taken branch on x0: tk); W4,
    // WP (pc + 4), WS, WC: the ring
    wire [3:0] wdo4   = sW ? wd4 : fM ? tap4 : (sWC & tm & ~tk) ? pk4 : ring[3:0];

    // ------------------------------------------------------------------------------------
    // Next slot after the tail
    // ------------------------------------------------------------------------------------
    reg [4:0] nsl;
    reg       nret, tgo;
    always @(*) begin
        nsl  = SL_W;
        nret = 1'b0;
        tgo  = 1'b0;
        case (sl)
            SL_F: begin
                if (trap_dec) begin
                    tgo = 1'b1;
                    nsl = SL_WC;
                end else
                    nsl = c_jal ? SL_W4 : p_mret ? SL_C : (c_fence | priv) ? SL_X :
                          spill ? SL_WP : liw ? SL_W : SL_A;
            end
            SL_WP: nsl = SL_A;
            SL_A: begin
                if (c_jalr & ~cmp) begin
                    tgo = 1'b1;
                    nsl = SL_WC;
                end else if (c_jalr) begin
                    nret = (rd_f == 4'd0);              // nothing to link
                    nsl  = SL_W4;
                end
                else if (c_br) begin
                    if (~rs2z)
                        nsl = SL_B;
                    else if (taken & insn[8]) begin
                        tgo = 1'b1;
                        nsl = SL_WC;
                    end else if (insn[8])
                        nsl = SL_X;
                    else
                        nret = 1'b1;                    // taken: the target is in the ring (tk)
                end else if (c_op)
                    nsl = SL_B;
                else if (c_st)
                    nsl = io ? SL_P : SL_BS;
                else if (c_ld & ~io)
                    nsl = SL_M;
                else if (c_csr)
                    nsl = SL_WS;
            end
            SL_B: begin
                if (c_br) begin
                    if (taken & insn[8]) begin
                        tgo = 1'b1;
                        nsl = SL_WC;
                    end else
                        nsl = SL_X;
                end
            end
            SL_P: begin
                nret = ~(c_st & io);                    // an IO store's P comes before BS
                nsl  = SL_BS;
            end
            SL_BS: begin
                nret = io;
                nsl  = SL_M;
            end
            SL_M:  nsl = c_st ? SL_P : SL_W;
            SL_WS: nsl = SL_C;
            SL_C: begin
                if (tm | p_mret) begin
                    nret = ~(tm & intr);                // an interrupt entry retires nothing
                    nsl  = SL_F;
                end
            end
            SL_W: begin
                nret = ~c_csr & ~spill;
                nsl  = c_csr ? SL_RS : SL_P;
            end
            SL_RS: nsl = SL_WC;
            SL_WC: begin
                nret = ~tm;
                nsl  = SL_C;
            end
            default: nret = 1'b1;                       // X, W4
        endcase
    end

    // ------------------------------------------------------------------------------------
    // IO: an IO load captures the slot into the ring at A's tail (atomic: the read side effect
    // happens at the same edge), as M would leave 4 bytes; an IO store writes rs2[15:0] from the
    // ring at BS's tail, its retirement.
    // ------------------------------------------------------------------------------------
    wire        io_re = e_end & sA & c_ld & io;
    wire        io_we = e_end & sBS & io;            // data: rs2[15:0] in ring[23:8]
    // the IO slot: the address's nibbles 0-1 are in the ring (A; an IO store: P, BS)
    wire [6:0]  mar_lo = ring[6:0];
    wire [1:0]  off   = mar_lo[1:0];
    wire [7:0]  iob0  = off[1] ? 8'd0 : off[0] ? io_rdata[15:8] : io_rdata[7:0];
    wire [7:0]  iob1  = (off == 2'd0) ? io_rdata[15:8] : 8'd0;

    // ------------------------------------------------------------------------------------
    // Ring and instruction register (no reset: nothing reads them before they are written)
    // ------------------------------------------------------------------------------------
    wire ring_in  = dstb & (fR | sF | (sM & c_ld)) & ~shB & ~(sA & c_jalr) & ~sP &
                    ~(sBS & io & n[2] & n[1]);
    // W of a shift rotates at its last rotn header strobes before c = 63 (8 header edges on the
    // bus, c = 56..63; a fast W starts at c = 63 - rotn)
    wire hrot     = stb & hdr & cn[5] & sW & c_sh & (cn[2:0] > ~rotn);
    // F and M rotate the ring and pcr by one nibble at each header nibble load (8 in all, so
    // both end where they started): the header's address nibbles then sit at odd positions
    // (r32v_mem). A read's dummy edges (cn[3] & cn[2]) load no address.
    wire hdr_ld   = (gap & ~booting & ~mask) | (stb & hdr & cn[5]);
    wire rot_hdr  = fM & hdr_ld & (gap | wr | ~(cn[3] & cn[2]));
    wire ring_rot = (dstb & (wr | (sP & ~n[2] & ~n[1]))) | hrot | rot_hdr;
    // pcr writes: A (the ring's pc + 4, also for a branch on x0 unless imm[1] = 1; a store: its
    // address; JALR: the target), B of a register shift (rs2), P (the spilled pc + 4), X, W4 of
    // JAL, W of LI and LUI (the ring's pc + 4), and C in a trap sequence or MRET. F and a trap
    // sequence's WC read the pc nibble by nibble: pcr rotates; so does JALR's A when the target
    // traps (target[1] is sumj[1] at nibble 0, then ~cmp), leaving the pc. The write enable is
    // decode only (no ALU term). A fetch after a taken branch on x0 (tk) moves the ring's target
    // into pcr.
    wire       jtrap = c_jalr & (n0 ? sumj[1] : ~cmp);
    wire       prot = sF | (sWC & tm);
    wire       pwr  = (sA & (~c_br | nbw)) | (sB & c_sh) | sP | sX | (sW4 & c_jal) |
                      (sC & (tm | p_mret)) | (sW & liw);
    // The memory reset sequence shifts zeros in (nib_m is 0 at the gap).
    wire       pwe  = (dstb & (pwr | prot)) | rot_hdr | booting;
    wire [3:0] pin4 = ((rot_hdr | (prot & ~(sF & tk)) | (sA & jtrap)) & ~booting) ? pcr[3:0] :
                      ((sA & ~c_st & ~c_jalr) | (sF & tk) | sW) ? ring[3:0] :
                      (sB | sP | booting) ? nib_m : din4;

    // ------------------------------------------------------------------------------------
    // Enable flops (no reset): the ring, the instruction register, the pc, the datapath flags
    // and the edge counter. Each is a scan flop (sky130_fd_sc_hd__sdfxtp_1, smaller than the
    // enable flop synthesis picks) that holds through its scan input: D = the next value,
    // SCD = Q, SCE = hold (contract section 1, CLAUDE.md).
    // ------------------------------------------------------------------------------------
    // ring: an IO load's capture (low half), else a shift in or a rotation (never both at once:
    // the top nibble takes din4 unless rotating; a right shift's header rotation brings in the
    // fill)
    wire        ring_sh = ring_in | ring_rot;
    wire [31:0] ring_d  = {((hrot & ~sh_left) ? {4{shf}} : ring_rot ? ring[3:0] : din4),
                           ring[31:20],
                           (io_re ? {iob1[3:0], iob1[7:4], iob0[3:0], iob0[7:4]} : ring[19:4])};
    wire [31:0] ring_h  = {{16{io_re | ~ring_sh}}, {16{~(io_re | ring_sh)}}};
    wire [31:0] ir_d    = {ir[27:0], nib_m};
    wire        ir_h    = ~(sF & dstb);
    wire [31:0] pcr_d   = {pin4, pcr[31:4]};
    wire        pcr_h   = ~pwe;
    // cy: cleared at the gap; a load's W latches the sign, the adder's slots the carry
    wire        cy_d    = ~gap & (sW ? tap4[3] : cout);
    wire        cy_h    = ~(gap | (dstb & (sW ? ~ldfill : (fR | sF | sW4))));
    // cmp: A of a branch (zc), SLT (ocmp), JALR (target[1] == 0), a shift (rs1[31] at the last
    // nibble); B of SLT and branches (ocmp)
    wire        cmp_d   = ~sA ? ocmp : c_br ? zc : c_slt ? ocmp : (c_jalr & n0) ? ~sumj[1] : a4[3];
    wire        cmp_h   = ~(dstb & ((sA & (c_br | c_slt | (c_jalr & n0) | c_sh)) | (sB & ~c_sh)));
    // c: also the low 6 bits of the memory reset sequence's counter (r32v_mem): 63 in reset,
    // then it counts every clock while booting. A slot starts it at 52 (read), 56 (write),
    // 0 (masked) or 63 - rotn (a fast shift W, fh)
    wire [5:0]  c_go    = {{2{~mask | fh}}, (mask ? fh : wr),
                           (mask ? (~rotn & {3{fh}}) : {~wr, 2'b00})};
    wire [5:0]  c_d     = ~rst_n ? 6'd63 : (gap & ~booting) ? c_go : cn;
    wire        c_h     = rst_n & ~(gap | stb);
    // x11: an x11 write slot (W, W4: fW) loads the emitted nibble into nibble c at its data
    // strobe c; every other a1r flop holds
    wire        a1w     = dstb & x11r & fW;
    wire [7:0]  a1we    = {8{a1w}} & (8'd1 << c[2:0]);
    genvar gi;
    generate
        for (gi = 0; gi < 32; gi = gi + 1) begin : g_rip
            sky130_fd_sc_hd__sdfxtp_1 u_ring (.CLK(clk), .D(ring_d[gi]), .SCD(ring[gi]),
                                              .SCE(ring_h[gi]), .Q(ring[gi]));
            sky130_fd_sc_hd__sdfxtp_1 u_ir (.CLK(clk), .D(ir_d[gi]), .SCD(ir[gi]), .SCE(ir_h),
                                            .Q(ir[gi]));
            sky130_fd_sc_hd__sdfxtp_1 u_pcr (.CLK(clk), .D(pcr_d[gi]), .SCD(pcr[gi]),
                                             .SCE(pcr_h), .Q(pcr[gi]));
            sky130_fd_sc_hd__sdfxtp_1 u_a1r (.CLK(clk), .D(wdo4[gi % 4]), .SCD(a1r[gi]),
                                             .SCE(~a1we[gi / 4]), .Q(a1r[gi]));
        end
        for (gi = 0; gi < 6; gi = gi + 1) begin : g_c
            sky130_fd_sc_hd__sdfxtp_1 u_c (.CLK(clk), .D(c_d[gi]), .SCD(c[gi]), .SCE(c_h),
                                           .Q(c[gi]));
        end
    endgenerate
    sky130_fd_sc_hd__sdfxtp_1 u_cy (.CLK(clk), .D(cy_d), .SCD(cy), .SCE(cy_h), .Q(cy));
    sky130_fd_sc_hd__sdfxtp_1 u_cmp (.CLK(clk), .D(cmp_d), .SCD(cmp), .SCE(cmp_h), .Q(cmp));
    sky130_fd_sc_hd__sdfxtp_1 u_mk (.CLK(clk), .D(mask), .SCD(mk), .SCE(~gap), .Q(mk));
    sky130_fd_sc_hd__sdfxtp_1 u_x11 (.CLK(clk), .D(x11), .SCD(x11r), .SCE(~gap), .Q(x11r));

    // ------------------------------------------------------------------------------------
    // Control (reset)
    // ------------------------------------------------------------------------------------
    wire tk_set = sA & nbw & taken;                     // at A's tail
    always @(posedge clk) begin
        if (!rst_n) begin
            sl    <= SL_F;
            ep    <= E_GAP;
            sck   <= 1'b0;
            tk    <= 1'b0;
        end else begin
            // toggles in HDR and DATA; a masked slot holds it high through DATA (a strobe per
            // clock; SCK stays low on the pin)
            sck <= gap ? (~booting & mask) : ((ep[0] ^ ep[1]) & (~sck | mk) & ~dend);
            case (ep)
                E_GAP:  if (~booting) ep <= (mask & ~fh) ? E_DATA : E_HDR;
                E_HDR:  if (stb & (c == 6'd63)) ep <= E_DATA;
                E_DATA: if (dend) ep <= E_TAIL;
                default: begin
                    sl <= nret ? (take ? SL_WC : SL_F) : nsl;
                    ep <= E_GAP;
                    tk <= tk_set;
                end
            endcase
        end
    end

    // ------------------------------------------------------------------------------------
    // Submodules
    // ------------------------------------------------------------------------------------
    // the address register's odd nibbles (r32v_mem): the ring for a load's M and after a taken
    // branch on x0 (tk), else pcr
    wire [15:0] pa_odd = (sM ? c_ld : tk) ? {ring[31:28], ring[23:20], ring[15:12], ring[7:4]} :
                                            {pcr[31:28], pcr[23:20], pcr[15:12], pcr[7:4]};

    r32v_mem u_mem (
        .clk(clk), .rst_n(rst_n),
        .cap_a(dstb & sA), .kn(n), .din4(din4),
        .io(io), .ps(ps), .booting(booting), .bc(c),
        .active(active), .prog(fM), .fetch(sF),
        .pa24(tk ? ring[24] : pcr[24]),
        .pa_odd(pa_odd),
        .sck(sck), .gap(gap),
        .hdr_ld(hdr_ld),
        .hidx(gap ? 3'd0 : (cn[2:0] ^ {~wr, 2'b00})),
        .h_wr(wr), .h_reg({regarea, rsel}),
        .dat_ld(dstb & wact), .wd4(wdo4),
        .oe_off(stb & hdr & ~wr & (cn[3:0] == 4'b1100)),
        .uio_out(uio_out), .uio_oe(uio_oe)
    );

    r32v_csr u_csr (
        .clk(clk), .rst_n(rst_n),
        .csr_num(insn[31:20]), .p_mret(p_mret), .s_wc(sWC), .kn(n),
        .region(csr_region), .idx(csr_idx), .mask_lo2(mask_lo2), .rd_die(rd_die),
        .trap_go(e_end & tgo), .cause(cause), .retire(e_end & nret),
        .wc_end(e_end & sWC & ~tm),
        .wb({ring[31], ring[11], ring[7], ring[3:0]}),
        .seq_end(e_end & sC & tm), .irq(irq),
        .tm(tm), .intr(intr), .take(take)
    );

    r32v_periph u_periph (
        .clk(clk), .rst_n(rst_n), .ui_in(ui_in), .uo_out(uo_out),
        .slot(mar_lo[6:2]), .off(off), .size(f3[1:0]), .we(io_we), .re(io_re),
        .wdata(ring[23:8]), .rdata(io_rdata), .irq(irq)
    );

    // ------------------------------------------------------------------------------------
    // RVFI (formal and cosim builds only; observes, never drives the pins)
    // ------------------------------------------------------------------------------------
`ifdef RISCV_FORMAL
    reg [63:0]  r_order;
    reg         r_v, r_tr, r_intr, r_ipend;
    reg [31:0]  r_rs1, r_rs2, r_rd, r_pc, r_npc, r_mrd;
    integer     mi;
    always @(posedge clk) begin
        if (!rst_n) begin
            r_order <= 64'd0;
            r_v     <= 1'b0;
            r_ipend <= 1'b0;
        end else begin
            r_v  <= e_end & nret;
            r_tr <= e_end & nret & tm;
            if (r_v)
                r_order <= r_order + 64'd1;
            // a trap or interrupt sequence ends: the next retirement is the handler's first
            // instruction (rvfi_intr = 1 for both, contract 8). A synchronous trap's own
            // retirement comes at this same tail and still reports the old value.
            if (e_end & sC & tm)
                r_ipend <= 1'b1;
            else if (e_end & nret)
                r_ipend <= 1'b0;
            if (e_end & nret)
                r_intr <= r_ipend;
        end
        if (e_end & sF)
            r_pc <= {pcr[31:2], 2'b00};
        if (dstb & pwr & ~(sA & c_st) & ~sB)            // every pc write covers nibbles 0..7
            r_npc <= {pin4, r_npc[31:4]};
        if (e_end & tk_set)                             // a taken branch on x0: the ring's target
            r_npc <= ring;
        if (dstb & sA)
            r_rs1 <= {nib_m, r_rs1[31:4]};
        else if (e_end & sF)                            // LI runs no A: rs1 = x0 reads 0
            r_rs1 <= 32'd0;
        if (dstb & (sB | sBS))
            r_rs2 <= {nib_m, r_rs2[31:4]};
        if (dstb & (sW | sW4))
            r_rd <= {wdo4, r_rd[31:4]};
        // M: byte n/2 of the load, high nibble first
        for (mi = 0; mi < 32; mi = mi + 1)
            if (dstb & sM & c_ld & ({n[2:1], ~n[0]} == mi[4:2]))
                r_mrd[mi] <= nib_m[mi[1:0]];
        if (io_re)
            r_mrd <= {16'd0, io_rdata} >> {off, 3'b000};
    end

    wire [31:0] imm_i = {{20{insn[31]}}, insn[31:20]};
    wire [31:0] imm_s = {{20{insn[31]}}, insn[31:25], insn[11:7]};
    wire        r_rs1e = ~trap_dec & (c_alu | c_mem | c_br | c_jalr | (c_csr & ~f3[2]));
    wire        r_rs2e = ~trap_dec & (c_br | c_st | c_op);
    wire        r_rde  = ~r_tr & (c_alu | c_u | c_jal | c_jalr | c_ld | c_csr) & (rd_f != 4'd0);
    wire        r_mem  = ~r_tr & c_mem;
    wire [31:0] maddr  = r_rs1 + (c_st ? imm_s : imm_i);
    wire [3:0]  r_mask = (f3[1:0] == 2'b00) ? 4'b0001 : (f3[1:0] == 2'b01) ? 4'b0011 : 4'b1111;
    wire [31:0] lmask  = {{8{r_mask[3]}}, {8{r_mask[2]}}, {8{r_mask[1]}}, {8{r_mask[0]}}};
    wire [31:0] r_rs2v = rs2z ? 32'd0 : r_rs2;          // a branch on x0 runs no B slot

    assign rvfi_valid     = r_v;
    assign rvfi_order     = r_order;
    assign rvfi_insn      = insn;
    assign rvfi_trap      = r_tr;
    assign rvfi_halt      = 1'b0;
    assign rvfi_intr      = r_intr;
    assign rvfi_mode      = 2'd3;
    assign rvfi_ixl       = 2'd1;
    assign rvfi_rs1_addr  = r_rs1e ? {1'b0, rs1_f} : 5'd0;
    assign rvfi_rs2_addr  = r_rs2e ? {1'b0, rs2_f} : 5'd0;
    assign rvfi_rs1_rdata = r_rs1e ? r_rs1 : 32'd0;
    assign rvfi_rs2_rdata = r_rs2e ? r_rs2v : 32'd0;
    assign rvfi_rd_addr   = r_rde ? {1'b0, rd_f} : 5'd0;
    assign rvfi_rd_wdata  = r_rde ? r_rd : 32'd0;
    assign rvfi_pc_rdata  = r_pc;
    assign rvfi_pc_wdata  = r_npc;
    assign rvfi_mem_addr  = r_mem ? maddr : 32'd0;
    assign rvfi_mem_rmask = (r_mem & c_ld) ? r_mask : 4'd0;
    assign rvfi_mem_wmask = (r_mem & c_st) ? r_mask : 4'd0;
    assign rvfi_mem_rdata = (r_mem & c_ld) ? (r_mrd & lmask) : 32'd0;
    assign rvfi_mem_wdata = (r_mem & c_st) ? (r_rs2v & lmask) : 32'd0;
`endif

endmodule

`default_nettype wire
