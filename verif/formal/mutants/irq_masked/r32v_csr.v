// MUTANT irq_masked: the interrupt ignores mstatus.MIE. An interrupt is taken with MIE = 0.
// Generated by verif/formal/mutants/make_mutants.py from the champion.
/*
 * BonettoR32V CSRs and trap/interrupt sequencing (docs/contract.md section 4).
 *
 * Where the CSRs live:
 * - mtvec, mscratch and mepc are words of the core region (PSRAM 0x7F_FF94, 0x7F_FF98,
 *   0x7F_FF9C): `region` = 1 and `idx` = 01, 10, 11. Bits 1:0 of mtvec and mepc are masked when
 *   read into the ring (`mask_lo2`), so they read 0 whatever was stored, the reset content
 *   included.
 * - mstatus.MIE/MPIE, mie.MEIE and mcause (bit 31 and bits 3:0) are flops here; mip.MEIP is the
 *   interrupt line. A C slot reads them through `rd_die` (nibble kn); the WC slot's END captures
 *   the new value's bits from the ring (`wb`).
 * - misa, mtval, the id CSRs and every unlisted number read 0 and ignore writes (unlisted
 *   numbers may alias a listed CSR: contract 4 leaves them unspecified).
 *
 * Sequencing: a synchronous trap (`trap_go`, at the END of the slot that detects it) or an
 * interrupt (`irq_take`, at a retirement; output `take`) sets `tm`. The core then runs WC C
 * with idx forced: WC writes mepc <- pc, C reads mtvec into the pc. `seq_end` (the C's END)
 * clears tm. MRET's C reads mepc. Entry: MPIE <- MIE, MIE <- 0, mcause <- cause. MRET's
 * retirement: MIE <- MPIE, MPIE <- 1. The interrupt is taken at a retirement where the next
 * MIE, the next MEIE and the line are all 1 (so a CSR write or MRET that changes them counts).
 *
 * Copyright 2026 Felipe Sens Bonetto
 * SPDX-License-Identifier: Apache-2.0
 */

`default_nettype none

module r32v_csr (
    input  wire        clk,
    input  wire        rst_n,
    input  wire [11:0] csr_num,    // insn[31:20]
    input  wire        p_mret,     // the instruction is MRET
    input  wire        s_wc,       // the slot is WC (else C), for idx in a trap sequence
    input  wire [2:0]  kn,         // C slot: nibble index of the strobe
    output wire        region,
    output wire [1:0]  idx,
    output wire        mask_lo2,   // bits 1:0 of this nibble read 0
    output wire [3:0]  rd_die,     // die bits 4kn+3 .. 4kn
    // events, each valid in an END cycle
    input  wire        trap_go,    // a synchronous trap starts
    input  wire [3:0]  cause,      // its mcause
    input  wire        retire,     // an instruction retires
    input  wire        wc_end,     // a CSR instruction's WC ends: capture the die bits
    input  wire [6:0]  wb,         // ring bits {31, 11, 7, 3, 2, 1, 0} at that END
    input  wire        seq_end,    // the trap or interrupt sequence's C ends
    input  wire        irq,        // mip.MEIP
    output reg         tm,         // in a trap or interrupt sequence
    output wire        intr,       // ... entered by an interrupt (valid while tm)
    output wire        take        // an interrupt is taken at this retirement
);

    reg       mie, mpie, meie;
    wire      mc31;
    wire [3:0] mc;

    // Decode (exact on the contract-4 numbers)
    wire b11 = csr_num[11], b6 = csr_num[6], b2 = csr_num[2], b1 = csr_num[1], b0 = csr_num[0];
    wire _unused = &{csr_num[10:7], csr_num[5:3], 1'b0};
    wire c_mstatus = ~b11 & ~b6 & ~b2 & ~b0;
    wire c_mie     = ~b11 & ~b6 &  b2 & ~b0;
    wire c_mtvec   = ~b11 & ~b6 &  b2 &  b0;
    wire c_mscr    = ~b11 &  b6 & ~b2 & ~b1 & ~b0;
    wire c_mepc    = ~b11 &  b6 & ~b2 & ~b1 &  b0;
    wire c_mcause  = ~b11 &  b6 & ~b2 &  b1 & ~b0;
    wire c_mip     = ~b11 &  b6 &  b2 & ~b0;

    assign region   = tm | p_mret | c_mtvec | c_mscr | c_mepc;
    assign idx      = tm ? {s_wc, 1'b1} : p_mret ? 2'b11 : {b6, b0};
    wire n0 = (kn == 3'd0);
    wire n1 = (kn == 3'd1);
    wire n2 = (kn == 3'd2);
    wire n3 = (kn == 3'd3);
    wire n7 = (kn == 3'd7);
    assign mask_lo2 = idx[0] & n0;                      // mtvec, mepc: bits 1:0 read 0

    // mstatus bits 3 (MIE), 7 (MPIE), 12:11 (MPP = 3); mie and mip bit 11; mcause 31, 3:0
    wire   mc_lo = c_mcause & n0;
    assign rd_die[0] = (c_mstatus & n3) | (mc_lo & mc[0]);
    assign rd_die[1] = mc_lo & mc[1];
    assign rd_die[2] = mc_lo & mc[2];
    assign rd_die[3] = (c_mstatus & ((n0 & mie) | (n1 & mpie) | n2)) |
                       (c_mie & n2 & meie) |
                       (c_mip & n2 & irq) |
                       (c_mcause & ((n7 & mc31) | (n0 & mc[3])));

    // Next MIE / MEIE as written at this END (for the interrupt decision)
    wire ws = wc_end & c_mstatus;
    // (an interrupt taken at the same END enters after them)
    wire mie_n  = ws ? wb[3] : (retire & p_mret) ? mpie : mie;
    wire meie_n = (wc_end & c_mie) ? wb[5] : meie;
    wire irq_take = retire & ~tm & meie_n & irq;

    assign take = irq_take;
    wire go = trap_go | irq_take;
    always @(posedge clk) begin
        if (!rst_n) begin
            mie  <= 1'b0;
            mpie <= 1'b0;                               // contract 4: MPIE resets to 0
            meie <= 1'b0;
            tm   <= 1'b0;
        end else begin
            mie  <= go ? 1'b0 : mie_n;
            meie <= meie_n;
            if (go)
                mpie <= mie_n;
            else if (ws)
                mpie <= wb[4];
            else if (retire & p_mret)
                mpie <= 1'b1;
            if (go)
                tm <= 1'b1;
            else if (seq_end)
                tm <= 1'b0;
        end
    end
    // mcause: scan flops holding through SCD (D = the next value, SCD = Q, SCE = hold)
    wire [4:0] mc_d = go ? {irq_take, (irq_take ? 4'd11 : cause)} : {wb[6], wb[3:0]};
    wire [4:0] mc_q;
    wire       mc_h = ~(go | (wc_end & c_mcause));
    genvar gi;
    generate
        for (gi = 0; gi < 5; gi = gi + 1) begin : g_mc
            sky130_fd_sc_hd__sdfxtp_1 u_mc (.CLK(clk), .D(mc_d[gi]), .SCD(mc_q[gi]), .SCE(mc_h),
                                            .Q(mc_q[gi]));
        end
    endgenerate
    assign {mc31, mc} = mc_q;
    // nothing writes mcause during a sequence, so its bit 31 tells an interrupt entry
    assign intr = mc31;

endmodule

`default_nettype wire
